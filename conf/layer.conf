## conf/layer.conf
```bitbake
# We have a conf and classes directory, add to BBPATH
BBPATH .= ":${LAYERDIR}"

# We have recipes-* directories, add to BBFILES
BBFILES += "${LAYERDIR}/recipes-*/*/*.bb \
            ${LAYERDIR}/recipes-*/*/*.bbappend"

BBFILE_COLLECTIONS += "meta-karo-stm"
BBFILE_PATTERN_meta-karo-stm = "^${LAYERDIR}/"
BBFILE_PRIORITY_meta-karo-stm = "8"

EULA_FILE_ST_${MACHINE} = "${LAYERDIR}/conf/eula/${MACHINE}"
EULA_FILE_ST_MD5SUM_${MACHINE} = "8b505090fb679839cefbcc784afe8ce9"

LAYERDEPENDS_meta-karo-stm = "core"
LAYERSERIES_COMPAT_meta-karo-stm = "thud"
```

## conf/machine/qsmp-1570-qsbase1.conf
```bitbake
#@TYPE: Machine
#@NAME: qsmp-1570-qsbase1
#@DESCRIPTION: Configuration for Ka-Ro electronics GmbH's QSMP-157C Evaluation Board
#@NEEDED_BSPLAYERS: layers/meta-karo-stm layers/meta-openembedded/meta-oe layers/meta-openembedded/meta-python

include conf/machine/include/st-machine-common-stm32mp.inc
include conf/machine/include/tune-cortexa7.inc

# =========================================================================
# Chip architecture
# =========================================================================
DEFAULTTUNE = "cortexa7thf-neon-vfpv4"
MACHINEOVERRIDES = "arm:armv7ve:stcommon:stm32mpcommon:qsmp-1570-qsbase1"

# =========================================================================
# boot schemes (see u-boot configurations in recipe)
# =========================================================================
BOOTSCHEME_LABELS += "basic"
BOOTSCHEME_LABELS += "mfg"
BOOTSCHEME_LABELS += "noenv"
BOOTSCHEME_LABELS += "trusted"

# =========================================================================
# Machine settings
# =========================================================================
# Define list of devicetree per board
STM32MP_DT_FILES_DK += "stm32mp157c-qsmp-1570"

# Extra DTB for board - need to specify it with .dtb ...
STM32MP_KERNEL_DEVICETREE_qsmp-1570-qsbase1 += "stm32mp157c-qsmp-1570-qsbase1.dtb"

# =========================================================================
# Machine features
# =========================================================================
#MACHINE_FEATURES += "bluetooth"
#MACHINE_FEATURES += "wifi"
MACHINE_FEATURES += "gpu"

# =========================================================================
# Image
# =========================================================================
# Add ubi FSTYPES to default ones for nand volumes
#IMAGE_FSTYPES += "stmultiubi"

# =========================================================================
# flashlayout
# =========================================================================
# Define the config labels to use to generate flashlayout file
FLASHLAYOUT_CONFIG_LABELS = "emmc"

# =========================================================================
# extlinux configuration
# =========================================================================
# As example, modify the default boot config for each target to M4 config
UBOOT_EXTLINUX_TARGETS = "emmc"
UBOOT_EXTLINUX_ROOT = "${EXTLINUX_ROOT_EMMC}"

# =========================================================================
# Trusted firmware debug
# =========================================================================
TF_DEBUG ?= "0"

# =========================================================================
# Flashlayouts
# =========================================================================
ENABLE_FLASHLAYOUT_CONFIG = "1"
FLASHLAYOUT_BOOTSCHEME_LABELS = "basic trusted"
BIN2BOOT_REPLACE_PATTERNS_fsbl1-boot = "basic;trusted"
BIN2BOOT_REPLACE_PATTERNS_ssbl-boot = "basic;mfg trusted;mfg"
FLASHLAYOUT_TYPE_LABELS_emmc = "${STM32MP_DT_FILES_DK} ${STM32MP_DT_FILES_DK}"
FLASHLAYOUT_PARTITION_DEVICE_emmc = "mmc0"
DEVICE_ALIGNMENT_SIZE_mmc0 = "0x00080000"
DEVICE_EMMC_qsmp-1570-qsbase1 = "mmc0"

# =========================================================================
# Kernel
# =========================================================================
KERNEL_DEFCONFIG_qsmp-1570-qsbase1 = "txmp_defconfig"
ST_KERNEL_LOADADDR_qsmp-1570-qsbase1 = "0xC0008000"
```

## conf/machine/txmp-1570.conf
```bitbake
#@TYPE: Machine
#@NAME: txmp-1570
#@DESCRIPTION: Configuration for Ka-Ro electronics GmbH's TXMP-1570 Evaluation Board
#@NEEDED_BSPLAYERS: layers/meta-karo-stm layers/meta-openembedded/meta-oe layers/meta-openembedded/meta-python

include conf/machine/include/st-machine-common-stm32mp.inc
include conf/machine/include/tune-cortexa7.inc

# =========================================================================
# Chip architecture
# =========================================================================
DEFAULTTUNE = "cortexa7thf-neon-vfpv4"
MACHINEOVERRIDES = "arm:armv7ve:stcommon:stm32mpcommon:txmp-1570"

# =========================================================================
# U-Boot configs
# =========================================================================
UBOOT_CONFIG[basic]   = "txmp-1570_defconfig,,u-boot.img"
UBOOT_CONFIG[noenv]   = "txmp-1570_noenv_defconfig,,u-boot.img"
UBOOT_CONFIG[mfg] = "txmp-1570_mfg_defconfig,,u-boot.stm32"
UBOOT_CONFIG[trusted] = "txmp-1570_trusted_defconfig,,u-boot.stm32"

# =========================================================================
# boot schemes (see u-boot configs)
# =========================================================================
BOOTSCHEME_LABELS += "basic"
BOOTSCHEME_LABELS += "mfg"
BOOTSCHEME_LABELS += "noenv"
BOOTSCHEME_LABELS += "trusted"

# =========================================================================
# Machine settings
# =========================================================================
# Define list of devicetree per board
STM32MP_DT_FILES_DK += "stm32mp157c-txmp-1570"

# Extra DTB for board - need to specify it with .dtb ...
STM32MP_KERNEL_DEVICETREE_txmp-1570 += "stm32mp157c-txmp-1570.dtb"
STM32MP_KERNEL_DEVICETREE_txmp-1570 += "stm32mp157c-txmp-1570-mb7.dtb"

# =========================================================================
# Machine features
# =========================================================================
#MACHINE_FEATURES += "bluetooth"
#MACHINE_FEATURES += "wifi"
MACHINE_FEATURES += "gpu"

# =========================================================================
# Image
# =========================================================================
# Add ubi FSTYPES to default ones for nand volumes
#IMAGE_FSTYPES += "stmultiubi"

# =========================================================================
# flashlayout
# =========================================================================
# Define the config labels to use to generate flashlayout file
FLASHLAYOUT_CONFIG_LABELS = "emmc"

# =========================================================================
# extlinux configuration
# =========================================================================
# As example, modify the default boot config for each target to M4 config
UBOOT_EXTLINUX_TARGETS = "emmc"
UBOOT_EXTLINUX_ROOT = "${EXTLINUX_ROOT_EMMC}"

# =========================================================================
# Trusted firmware debug
# =========================================================================
TF_DEBUG ?= "0"

# =========================================================================
# Flashlayouts
# =========================================================================
ENABLE_FLASHLAYOUT_CONFIG = "1"
FLASHLAYOUT_BOOTSCHEME_LABELS = "basic trusted"
BIN2BOOT_REPLACE_PATTERNS_fsbl1-boot = "basic;trusted"
BIN2BOOT_REPLACE_PATTERNS_ssbl-boot = "basic;mfg trusted;mfg"
FLASHLAYOUT_TYPE_LABELS_emmc = "${STM32MP_DT_FILES_DK} ${STM32MP_DT_FILES_DK}"
FLASHLAYOUT_PARTITION_DEVICE_emmc = "mmc0"
DEVICE_ALIGNMENT_SIZE_mmc0 = "0x00080000"
DEVICE_EMMC_txmp-1570 = "mmc0"

# =========================================================================
# Kernel
# =========================================================================
KERNEL_DEFCONFIG_txmp-1570 = "txmp_defconfig"
ST_KERNEL_LOADADDR_txmp-1570 = "0xC0008000"
```
